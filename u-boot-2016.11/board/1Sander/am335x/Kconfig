## u-boot-2016.11/board/1Sander/am335x/Kconfig
```kconfig
if TARGET_AM335X_WYG

config SPL_ENV_SUPPORT
	default y

config SPL_WATCHDOG_SUPPORT
	default y

config SPL_YMODEM_SUPPORT
	default y

config SYS_BOARD
	default "am335x"

config SYS_VENDOR
	default "1Sander"

config SYS_SOC
	default "am33xx"

config SYS_CONFIG_NAME
	default "am335x_wyg"

config CONS_INDEX
	int "UART used for console"
	range 1 6
	default 1
	help
	  The AM335x SoC has a total of 6 UARTs (UART0 to UART5 as referenced
	  in documentation, etc) available to it.  Depending on your specific
	  board you may want something other than UART0 as for example the IDK
	  uses UART3 so enter 4 here.

config NOR
	bool "Support for NOR flash"
	help
	  The AM335x SoC supports having a NOR flash connected to the GPMC.
	  In practice this is seen as a NOR flash module connected to the
	  "memory cape" for the BeagleBone family.

source "board/1Sander/common/Kconfig"

endif
```
